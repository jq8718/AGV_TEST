## legacy_gpio_demo/sdkconfig.defaults
```kconfig
CONFIG_ESP_CONSOLE_USB_SERIAL_JTAG=y
CONFIG_FREERTOS_HZ=1000
CONFIG_ESP32P4_REV_MIN_301=y
CONFIG_ESPTOOLPY_FLASHSIZE_16MB=y
CONFIG_SPIRAM=y
CONFIG_SPIRAM_BOOT_INIT=y
CONFIG_SPIRAM_MEMTEST=y
CONFIG_SPIRAM_IGNORE_NOTFOUND=y
CONFIG_LOG_DEFAULT_LEVEL_INFO=y
CONFIG_RTC_CLK_SRC_EXT_CRYS=y
CONFIG_RTC_CLK_CAL_CYCLES=3000
# ESP32-P4 v3.2 supports PSRAM interface up to 250 MHz per PCN202600801.
CONFIG_SPIRAM_SPEED_250M=y
CONFIG_SPIRAM_SPEED=250
CONFIG_ESP_DEFAULT_CPU_FREQ_MHZ_400=y
CONFIG_ESP_DEFAULT_CPU_FREQ_MHZ=400
```

## port/components/ov01c1b/Kconfig
```kconfig
menuconfig CAMERA_OV01C1B
    bool "OV01C1B"
    default y if P4SCAN_SENSOR_E6 || P4SCAN_SENSOR_AUTO
    depends on SOC_MIPI_CSI_SUPPORTED && (P4SCAN_SENSOR_E6 || P4SCAN_SENSOR_AUTO)
    help
        Enable support for the OV01C1B CMOS image sensor.

if CAMERA_OV01C1B
    config CAMERA_OV01C1B_AE_MAX_EXPOSURE_US
        int "AE maximum exposure in microseconds (0 uses sensor default)"
        range 0 10000
        default 0

    config CAMERA_OV01C1B_AE_MAX_GAIN
        int "AE maximum digital gain multiplier"
        range 1 15
        default 15

    config CAMERA_OV01C1B_FIXED_EXPOSURE_US
        int "Fixed exposure test in microseconds (0 disables)"
        range 0 10000
        default 0
        help
            Uses the configured ISP Tline period. Locks exposure writes so AE
            cannot lengthen integration. Verify timing on the actual sensor.

    config CAMERA_OV01C1B_FIXED_GAIN
        int "Fixed digital gain multiplier (0 disables)"
        range 0 15
        default 0
        help
            Locks sensor digital gain writes, including IPA requests, to this
            multiplier. Intended for controlled short-exposure tests.

    config CAMERA_OV01C1B_AUTO_DETECT_MIPI_INTERFACE_SENSOR
        bool "Detect OV01C1B on MIPI CSI interface"
        default y

    config CAMERA_OV01C1B_MIPI_RAW10_1024X1024_50FPS
        bool "MIPI 1-lane, 24M input, 1024x1024 50fps, RAW10"
        default y

    choice CAMERA_OV01C1B_MIPI_DEFAULT_FMT
        prompt "Select default output format for MIPI CSI interface"
        default CAMERA_OV01C1B_MIPI_DEFAULT_FMT_RAW10_1024X1024_50FPS

        config CAMERA_OV01C1B_MIPI_DEFAULT_FMT_RAW10_1024X1024_50FPS
            bool "MIPI 1-lane, 24M input, 1024x1024 50fps, RAW10"
            depends on CAMERA_OV01C1B_MIPI_RAW10_1024X1024_50FPS
    endchoice

    config CAMERA_OV01C1B_MIPI_IF_FORMAT_INDEX_DEFAULT
        int
        default 0 if CAMERA_OV01C1B_MIPI_DEFAULT_FMT_RAW10_1024X1024_50FPS

    config CAMERA_OV01C1B_MIPI_CLK_MHZ
        int "MIPI lane bit rate in MHz"
        range 100 1500
        default 1300
        help
            The 1024x1024 50fps vendor register file specifies 1300Mbps/lane.

    config CAMERA_OV01C1B_FIXED_GAIN_4X_TEST
        bool "Fix sensor gain for exposure testing"
        default n
        help
            Restrict the sensor gain menu to the raw register selected below so
            the ISP/IPA exposure response can be tested independently of gain.

    config CAMERA_OV01C1B_FIXED_GAIN_RAW
        int "Fixed sensor gain raw register"
        range 64 2048
        default 128
        depends on CAMERA_OV01C1B_FIXED_GAIN_4X_TEST
        help
            OV01C1B gain is raw_register / 64. Use 64, 128, 256, 512, 1024,
            or 2048 for 1x, 2x, 4x, 8x, 16x, or 32x test points.

    config CAMERA_OV01C1B_KEEP_STREAM_ON
        bool "Keep OV01C1B stream enabled when CSI stops"
        default n
        help
            Keep the sensor transmitting MIPI after the CSI video device is
            stopped. This is only for probing the MIPI clock during bring-up;
            it prevents a later CSI reopen from restarting the sensor cleanly.

    config CAMERA_OV01C1B_TEST_PATTERN
        bool "Enable OV01C1B internal test pattern"
        default n
        help
            Enable the sensor's internal test pattern registers for MIPI/CSI
            bring-up. The test pattern is monochrome and is not camera output.

    config CAMERA_OV01C1B_COLORBAR_FULL_1032X1032
        bool "Use 1032x1032 CSI dimensions for ColorBar"
        depends on CAMERA_OV01C1B_TEST_PATTERN
        default n
        help
            OV01C1B ColorBar output uses the sensor's full 1032x1032 pattern
            size. Enable this only when the internal ColorBar is enabled.

    choice CAMERA_OV01C1B_BAYER_PATTERN
        prompt "Bayer pattern"
        default CAMERA_OV01C1B_BAYER_BGGR
        help
            Temporary bring-up default. Confirm with raw frame analysis later.

        config CAMERA_OV01C1B_BAYER_RGGB
            bool "RGGB"
        config CAMERA_OV01C1B_BAYER_GRBG
            bool "GRBG"
        config CAMERA_OV01C1B_BAYER_GBRG
            bool "GBRG"
        config CAMERA_OV01C1B_BAYER_BGGR
            bool "BGGR"
    endchoice
endif
```

## sdkconfig.defaults
```kconfig
CONFIG_IDF_TARGET="esp32p4"
CONFIG_FREERTOS_HZ=1000
CONFIG_ESPTOOLPY_FLASHSIZE_16MB=y
CONFIG_SPIRAM=y
CONFIG_SPIRAM_MODE_HEX=y
CONFIG_SPIRAM_USE_MALLOC=y
CONFIG_SPIRAM_MALLOC_ALWAYSINTERNAL=16384
CONFIG_IDF_EXPERIMENTAL_FEATURES=y
CONFIG_PARTITION_TABLE_CUSTOM=y
CONFIG_PARTITION_TABLE_CUSTOM_FILENAME="partitions.csv"
CONFIG_COMPILER_OPTIMIZATION_PERF=y
CONFIG_COMPILER_CXX_EXCEPTIONS=y
CONFIG_LOG_DEFAULT_LEVEL_INFO=y
CONFIG_ESP_MAIN_TASK_STACK_SIZE=8192
CONFIG_ESP_TASK_WDT_EN=n

# OV9281: 2-lane MIPI CSI, 24 MHz XCLK, 1280x720 RAW8 at 50 fps.
CONFIG_P4SCAN_CAMERA_APP=y
CONFIG_P4SCAN_CONTINUOUS_SCAN=y
CONFIG_P4SCAN_QR_FAST_SEARCH=y
CONFIG_P4SCAN_TRIGGER_GPIO=35
CONFIG_P4SCAN_LIGHT_DIAGNOSTIC=n
CONFIG_P4SCAN_SOFTWARE_TRIGGER_ON_BOOT=n
CONFIG_P4SCAN_DUMP_FRAME_TO_FLASH=n
CONFIG_ESP_VIDEO_ENABLE_MIPI_CSI_VIDEO_DEVICE=y
CONFIG_ESP_VIDEO_ENABLE_ISP=y
CONFIG_ESP_VIDEO_ENABLE_ISP_PIPELINE_CONTROLLER=y
CONFIG_ESP_VIDEO_DISABLE_MIPI_CSI_DRIVER_BACKUP_BUFFER=y
CONFIG_TINYUSB_RHPORT_HS=y
CONFIG_TUSB_PID=0x8001
CONFIG_UVC_MODE_ISOC_CAM1=y
CONFIG_UVC_CAM1_FRAMESIZE_WIDTH=1024
CONFIG_UVC_CAM1_FRAMESIZE_HEIGT=1024
CONFIG_UVC_CAM1_MULTI_FRAMESIZE=n
CONFIG_UVC_TINYUSB_TASK_CORE=0
CONFIG_UVC_CAM1_TASK_CORE=0
CONFIG_UVC_CAM1_FRAMERATE=30
CONFIG_FREERTOS_GENERATE_RUN_TIME_STATS=y
CONFIG_FREERTOS_RUN_TIME_COUNTER_TYPE_U32=y
CONFIG_FREERTOS_RUN_TIME_STATS_USING_ESP_TIMER=y

CONFIG_UVC_TINYUSB_TASK_PRIORITY=10

CONFIG_UVC_CAM1_TASK_PRIORITY=9

# CONFIG_UVC_MODE_BULK_CAM1 is not set

CONFIG_P4SCAN_FRAME_STAGE_PIPELINE=y
# CONFIG_P4SCAN_PIPELINE_DIAGNOSTICS is not set

CONFIG_ESP_CONSOLE_USB_SERIAL_JTAG=y
CONFIG_ESP32P4_REV_MIN_301=y
CONFIG_SPIRAM_SPEED_250M=y
CONFIG_SPIRAM_MEMTEST=y
CONFIG_ESP_DEFAULT_CPU_FREQ_MHZ_400=y
CONFIG_RTC_CLK_SRC_EXT_CRYS=y
CONFIG_RTC_CLK_CAL_CYCLES=3000
CONFIG_CAMERA_OV01C1B=y
CONFIG_CAMERA_OV01C1B_AUTO_DETECT_MIPI_INTERFACE_SENSOR=y
CONFIG_CAMERA_OV01C1B_MIPI_RAW10_1024X1024_50FPS=y
CONFIG_CAMERA_OV01C1B_MIPI_DEFAULT_FMT_RAW10_1024X1024_50FPS=y
CONFIG_CAMERA_OV01C1B_MIPI_CLK_MHZ=1300
CONFIG_CAMERA_OV01C1B_AE_MAX_EXPOSURE_US=10000
CONFIG_CAMERA_OV01C1B_AE_MAX_GAIN=15
CONFIG_TUSB_PRODUCT="AGV SCAN E6 UVC+CDC"
```
